## config/boards/shields/cirque/Kconfig.defconfig
```kconfig
# Copyright (c) 2022 The ZMK Contributors
# SPDX-License-Identifier: MIT

if CIRQUE_DONGLE

config ZMK_KEYBOARD_NAME
    default "cirque"

config ZMK_SPLIT_ROLE_CENTRAL
     default y

config DT_HAS_CIRQUE_PINNACLE_ENABLED
    default y

config ZMK_USB
    default y

config ZMK_SPLIT
    default y

config ZMK_BLE
    default y

endif
```

## config/boards/shields/cirque/Kconfig.shield
```kconfig
# Copyright (c) 2022 The ZMK Contributors
# SPDX-License-Identifier: MIT

config CIRQUE_DONGLE
    def_bool $(shields_list_contains,cirque_dongle)
```

## config/boards/shields/totem/Kconfig.defconfig
```kconfig
# Copyright (c) 2022 The ZMK Contributors
# SPDX-License-Identifier: MIT

if SHIELD_TOTEM_DONGLE

config ZMK_KEYBOARD_NAME
    default "TOTEM dongle"
    
config ZMK_SPLIT_ROLE_CENTRAL
    default y

config ZMK_USB
    default y

endif

if ZMK_DISPLAY

config I2C
    default y

config SSD1306
    default y

choice ZMK_DISPLAY_WORK_QUEUE
    default ZMK_DISPLAY_WORK_QUEUE_DEDICATED
endchoice

endif

if SHIELD_TOTEM_LEFT || SHIELD_TOTEM_RIGHT || SHIELD_TOTEM_DONGLE

config ZMK_SPLIT
    default y

config ZMK_BLE
    default y

endif
```

## config/west.yml
```yaml
manifest:
  defaults:
    remote: urob
    revision: v0.2 # Pin everything to v0.2
  remotes:
    - name: zmkfirmware
      url-base: https://github.com/zmkfirmware
    - name: urob
      url-base: https://github.com/urob
    - name: englmaxi
      url-base: https://github.com/englmaxi
  projects:
    - name: zmk-dongle-display
      remote: englmaxi
      revision: main
    - name: zmk
      remote: zmkfirmware
      import: app/west.yml

    # ZMK modules
    - name: zmk-adaptive-key
      path: modules/zmk/adaptive-key
    - name: zmk-auto-layer
      path: modules/zmk/auto-layer
    - name: zmk-helpers
      path: modules/zmk/helpers
    - name: zmk-leader-key
      path: modules/zmk/leader-key
    - name: zmk-tri-state
      path: modules/zmk/tri-state

     # Temporarily overload Zephyr until
    # https://github.com/zmkfirmware/zephyr/pull/40 is merged.
    - name: zephyr
      revision: v3.5.0+zmk-fixes
      clone-depth: 1
      import:
        # Only enable most commonly used boards. For less common hardware one
        # may need to enable additional modules.
        name-allowlist:
          - cmsis
          - hal_nordic
          - hal_rpi_pico
          - hal_stm32
          - lvgl
          - tinycrypt
  self:
    path: config
```
