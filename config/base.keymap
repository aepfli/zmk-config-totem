
#include <behaviors.dtsi>
#include <behaviors/num_word.dtsi>
#include <dt-bindings/zmk/bt.h>
#include <dt-bindings/zmk/keys.h>
#include <dt-bindings/zmk/outputs.h>
#include "zmk-helpers/helper.h"

#define DEF     0
#define SYMT    1
#define NAV     2
#define SYMC    3
#define NUM     4
#define FN      5
#define IDEA    6
#define MOUSE   7
#define MC      7

#define XXXX &none
#define ____ &trans

#define QUICK_TAP_MS 175

&sk {  // sticky-key config
    release-after-ms = <900>;  // release after 0.6s
    quick-release;             // no double capitalization when rolling keys
};

&sl {  // sticky-layer config
    ignore-modifiers;          // allow chording sticky mods & layers
};

&lt {  // layer-tap config
    flavor = "balanced";
    tapping-term-ms = <200>;
    quick-tap-ms = <QUICK_TAP_MS>;
};


/* Homerow mods */

#define KEYS_L LT0 LT1 LT2 LT3 LT4 LM0 LM1 LM2 LM3 LM4 LB0 LB1 LB2 LB3 LB4  // left hand
#define KEYS_R RT0 RT1 RT2 RT3 RT4 RM0 RM1 RM2 RM3 RM4 RB0 RB1 RB2 RB3 RB4 // right hand
#define THUMBS LH2 LH1 LH0 RH0 RH1 RH2                                      // thumbs

#define MAKE_HRM(NAME, HOLD, TAP, TRIGGER_POS)                                 \
  ZMK_HOLD_TAP(NAME, bindings = <HOLD>, <TAP>; flavor = "balanced";            \
               tapping-term-ms = <280>; quick-tap-ms = <QUICK_TAP_MS>;         \
               require-prior-idle-ms = <150>; hold-trigger-on-release;         \
               hold-trigger-key-positions = <TRIGGER_POS>;)

MAKE_HRM(hml, &kp, &kp, KEYS_R THUMBS) // Left-hand HRMs.
MAKE_HRM(hmr, &kp, &kp, KEYS_L THUMBS) // Right-hand HRMs.

// Hack: Make HRM combos tap-only (cf, ZMK issue #544).
#define ZMK_COMBO_8(NAME, TAP, POS, LAYERS, COMBO_MS, IDLE_MS, HOLD, SIDE)     \
  MAKE_HRM(hm_combo_##NAME, &kp, TAP, SIDE THUMBS)                             \
  ZMK_COMBO_6(NAME, &hm_combo_##NAME HOLD 0, POS, LAYERS, COMBO_MS, IDLE_MS)

/* Combos, leader key sequences */

#include "mouse.dtsi"
#include "combos.dtsi"  // requires layer aliases
#include "extra_keys.h"

/* Nav cluster */
// Trigger tap-action on all interrupts.
#define MT_CORE                                                                \
  flavor = "tap-preferred";                                                    \
  tapping-term-ms = <220>;                                                     \
  quick-tap-ms = <220>;                                                        \
  hold-trigger-key-positions = <0>;

&mt { MT_CORE };

ZMK_HOLD_TAP(mt_home, bindings = <&masked_home>, <&kp>; MT_CORE)
ZMK_HOLD_TAP(mt_end, bindings = <&masked_end>, <&kp>; MT_CORE)

#define NAV_LEFT  &mt_home 0   LEFT  // Tap: left  | Long-tap: start of line.
#define NAV_RIGHT &mt_end 0    RIGHT // Tap: right | Long-tap: end   of line.
#define NAV_UP    &mt LC(HOME) UP    // Tap: up    | Long-tap: start of doc.
#define NAV_DOWN  &mt LC(END)  DOWN  // Tap: down  | Long-tap: end   of doc.
#define NAV_BSPC  &mt LC(BSPC) BSPC  // Tap: bspc  | Long-tap: delete word bwd.
#define NAV_DEL   &mt LC(DEL)  DEL   // Tap: del   | Long-tap: delete word fwd.

// mask CTRL when holding left/right to avoid accidental jumps to beginning/end of document
#define MASK_MODS(NAME, MODS, BINDING) \
    ZMK_BEHAVIOR(NAME, mod_morph, \
        bindings = <BINDING>, <BINDING>; \
        mods = <MODS>; \
    )

MASK_MODS(masked_home, (MOD_LCTL), &kp HOME)
MASK_MODS(masked_end,  (MOD_LCTL), &kp END)

/* Caps-word, num-word and smart-mouse */

// tap: sticky-shift | shift + tap/ double-tap: caps-word | hold: shift
ZMK_BEHAVIOR(smart_shft, mod_morph,
    bindings = <&sk LSHFT>, <&caps_word>;
    mods = <(MOD_LSFT)>;
)
&caps_word {  // mods deactivate caps-word, requires PR #1451
    /delete-property/ ignore-modifiers;
};

// tap: num-word | double-tap: sticky num-layer | hold: num-layer
#define SMART_NUM &smart_num NUM 0
#define SMART_NUM &smart_num NUM 0
ZMK_HOLD_TAP(smart_num, bindings = <&mo>, <&num_dance>; flavor = "balanced";
             tapping-term-ms = <200>; quick-tap-ms = <QUICK_TAP_MS>;)

ZMK_TAP_DANCE(num_dance, bindings = <&num_word NUM>, <&sl FN>;
              tapping-term-ms = <200>;)
&num_word {  // num-word, requires PR #1451
    continue-list = <BSPC DEL DOT COMMA PLUS MINUS STAR FSLH EQUAL COLON>;
};

/* Custom behaviors */

// Alt+Tab swapper, requires PR #1366
ZMK_BEHAVIOR(swapper, tri_state,
    bindings = <&kt LGUI>, <&kp TAB>, <&kt LGUI>;
    ignored-key-positions = <LT2>;
)

// reuse basic mod-morph scheme
#define SIMPLE_MORPH(NAME, MOD, BINDING1, BINDING2) \
    ZMK_BEHAVIOR(NAME, mod_morph, \
        mods = <(MOD_L ## MOD|MOD_R ## MOD)>; \
        bindings = <BINDING1>, <BINDING2>; \
    )

// tap: comma | shift + tap: semicolon | ctrl + shift + tap: <
SIMPLE_MORPH(comma_morph, SFT, &kp COMMA, &comma_inner_morph)
SIMPLE_MORPH(comma_inner_morph, CTL, &kp SEMICOLON, &kp LESS_THAN)

// tap: dot | shift + tap: colon | ctrl + shift + tap: >
SIMPLE_MORPH(dot_morph, SFT, &kp DOT, &dot_inner_morph)
SIMPLE_MORPH(dot_inner_morph, CTL, &kp COLON, &kp GREATER_THAN)


// tap: sqt | shift + tap: dqt | ctrl + shift + tap: backtick
SIMPLE_MORPH(sqt_morph, CTL, &kp SQT, &kp GRAVE)

// tap: qmark | shift + tap: excl
SIMPLE_MORPH(qexcl, SFT, &kp QMARK, &kp EXCL)

// tap: left/right parenthesis | shft + tap: less-than/greater-than
SIMPLE_MORPH(lpar_lt, SFT, &kp LPAR, &kp LT)
SIMPLE_MORPH(rpar_gt, SFT, &kp RPAR, &kp GT)

// tap: space | shift + tap: dot -> space -> sticky shift | hold: activate layer
ZMK_HOLD_TAP(lt_spc,
    flavor = "balanced";
    tapping-term-ms = <200>;
    quick-tap-ms = <QUICK_TAP_MS>;
    bindings = <&mo>, <&spc_morph>;
)
SIMPLE_MORPH(spc_morph, SFT, &kp SPACE, &dot_spc)
ZMK_BEHAVIOR(dot_spc, macro,
    wait-ms = <0>;
    tap-ms = <5>;
    bindings = <&kp DOT &kp SPACE &sk LSHFT>;
)

// tap: backspace | lshft + tap: delete | rshft + tap: shift-delete
//ZMK_BEHAVIOR(bs_del, mod_morph,
//    bindings = <&kp BSPC>, <&kp DEL>;
//    mods = <(MOD_LSFT|MOD_RSFT)>;
//    keep-mods = <MOD_RSFT>;
//)
//
//ZMK_BEHAVIOR(bs_dc, tap_dance,
//    tapping-term-ms = <200>;
//    bindings = <&bs_del>, <&kp LC(BSPC)>;
//)
ZMK_HOLD_TAP(lt_bs,
    flavor = "balanced";
    tapping-term-ms = <200>;
    quick-tap-ms = <QUICK_TAP_MS>;
    bindings = <&mo>, <&bs_dc>;
)

ZMK_BEHAVIOR(bs_dc, tap_dance,
    tapping-term-ms = <200>;
    bindings = <&kp BSPC>, <&kp LC(BSPC)>;
)
// tap: delete | double-tap: control-delete | hold: activate layer
ZMK_HOLD_TAP(lt_del,
    flavor = "balanced";
    tapping-term-ms = <200>;
    quick-tap-ms = <QUICK_TAP_MS>;
    bindings = <&mo>, <&del_dc>;
)

ZMK_BEHAVIOR(del_dc, tap_dance,
    tapping-term-ms = <200>;
    bindings = <&kp DEL>, <&kp LC(DEL)>;
)

// tap: copy | double-tap: cut
ZMK_BEHAVIOR(copy_cut, tap_dance,
    tapping-term-ms = <200>;
    bindings = <&kp LC(C)>, <&kp LC(X)>;
)

// tap: paste | double-tap: alt shift v
ZMK_BEHAVIOR(paste_q, tap_dance,
    tapping-term-ms = <200>;
    bindings = <&kp LC(V)>, <&kp LS(LA(V))>;
)

ZMK_HOLD_TAP(mo_tog,
    tapping-term-ms = <200>;
    quick-tap-ms = <QUICK_TAP_MS>;
    bindings = <&mo>, <&tog>;
    require-prior-idle-ms = <100>;
)

ZMK_HOLD_TAP(repmo,
    tapping-term-ms = <200>;
    quick-tap-ms = <QUICK_TAP_MS>;
    bindings = <&mo>, <&key_repeat>;
    require-prior-idle-ms = <100>;
)

ZMK_UNICODE_SINGLE(eur, N2, N0, A, C)

#define T_R_LFT &repmo MOUSE 0
#define T_R_MID &lt NAV TAB
#define T_R_RGT &lt_spc SYMT 0
#define T_L_LFT &lt_bs SYMC 0
#define T_L_MID &lt_del IDEA 0
#define T_L_RGT SMART_NUM

ZMK_LAYER(base,
//╭──────╮ ╭─────────────┬─────────────┬─────────────┬─────────────┬─────────────╮ ╭─────────────┬─────────────┬─────────────┬─────────────┬─────────────╮ ╭──────╮
             &kp Q         &kp W         &kp E         &kp R         &kp T           &kp Y         &kp U         &kp I         &kp O         &sqt_morph          
//├──────┤ ├─────────────┼─────────────┼─────────────┼─────────────┼─────────────┤ ├─────────────┼─────────────┼─────────────┼─────────────┼─────────────┤ ├──────┤
             &hml LGUI A   &hml LALT S   &hml LCTRL D  &hml LSHFT F  &kp G           &kp H         &hmr RSHFT J  &hmr LCTRL K  &hmr LALT L   &hmr LGUI P         
//├──────┤ ├─────────────┼─────────────┼─────────────┼─────────────┼─────────────┤ ├─────────────┼─────────────┼─────────────┼─────────────┼─────────────┤ ├──────┤
    X_LB     &kp Z         &kp X         &kp C         &kp V         &kp B           &kp N         &kp M         &comma_morph  &dot_morph    &qexcl          X_RB
//├──────┤ ╰─────────────┴─────────────┼─────────────┼─────────────┼─────────────┤ ├─────────────┼─────────────┼─────────────┼─────────────┴─────────────╯ ├──────┤
                                         T_R_LFT       T_R_MID       T_R_RGT         T_L_LFT      T_L_MID       T_L_RGT                                          
//╰──────╯                             ╰─────────────┴─────────────┴─────────────╯ ╰─────────────┴─────────────┴─────────────╯                             ╰──────╯
)

ZMK_LAYER(sym_type,
//╭──────╮ ╭─────────────┬─────────────┬─────────────┬─────────────┬─────────────╮ ╭─────────────┬─────────────┬─────────────┬─────────────┬─────────────╮ ╭──────╮
             ____          ____          ____          ____          ____            &kp UNDER     &kp EQUAL     &kp HASH      &kp PERCENT   &kp GRAVE           
//├──────┤ ├─────────────┼─────────────┼─────────────┼─────────────┼─────────────┤ ├─────────────┼─────────────┼─────────────┼─────────────┼─────────────┤ ├──────┤
             &sk LGUI      &sk LALT      &sk LCTRL     &sk LSHFT     ____            &kp MINUS     &kp PLUS      &kp AT        &kp AMPS      &kp FSLH            
//├──────┤ ├─────────────┼─────────────┼─────────────┼─────────────┼─────────────┤ ├─────────────┼─────────────┼─────────────┼─────────────┼─────────────┤ ├──────┤
    X_LB     ____          ____          ____          ____          ____            &kp TILDE     &kp STAR      &kp CARET     &kp PIPE      &kp BSLH        X_RB
//├──────┤ ╰─────────────┴─────────────┼─────────────┼─────────────┼─────────────┤ ├─────────────┼─────────────┼─────────────┼─────────────┴─────────────╯ ├──────┤
                                         ____          ____          ____            ____           ____           ____                                          
//╰──────╯                             ╰─────────────┴─────────────┴─────────────╯ ╰─────────────┴─────────────┴─────────────╯                             ╰──────╯
)

ZMK_BEHAVIOR(i3_sw, hold_tap,
    flavor = "balanced";
    tapping-term-ms = <200>;
    quick-tap-ms = <QUICK_TAP_MS>;
    bindings = <&kp>, <&kp>;
)

ZMK_BEHAVIOR(i3_1, tap_dance,
    tapping-term-ms = <200>;
    bindings = <&mt LA(LG(N1)) LG(N1)>, <&kp LS(LG(N1))>;
)

ZMK_BEHAVIOR(i3_2, tap_dance,
    tapping-term-ms = <200>;
    bindings = <&mt LA(LG(N2)) LG(N2)>, <&kp LS(LG(N2))>;
)

ZMK_BEHAVIOR(i3_3, tap_dance,
    tapping-term-ms = <200>;
    bindings = <&mt LA(LG(N3)) LG(N3)>, <&kp LS(LG(N3))>;
)

ZMK_BEHAVIOR(i3_4, tap_dance,
    tapping-term-ms = <200>;
    bindings = <&mt LA(LG(N4)) LG(N4)>, <&kp LS(LG(N4))>;
)

ZMK_BEHAVIOR(i3_5, tap_dance,
    tapping-term-ms = <200>;
    bindings = <&mt LA(LG(N5)) LG(N5)>, <&kp LS(LG(N5))>;
)
#define I3_S(wsp) &as LS(keycode) keycode
#define I3_1    &i3_1
#define I3_2    &i3_2
#define I3_3    &i3_3
#define I3_4    &i3_4
#define I3_5    &i3_5
#define I3_SCR  &mt LG(LC(M)) LG(LC(A))
#define I3_Q    &mt LG(LA(Q)) LG(LS(Q))
#define I3_F    &mt LG(F) LG(LS(F))


ZMK_LAYER(nav,
//╭──────╮ ╭─────────────┬─────────────┬─────────────┬─────────────┬─────────────╮ ╭─────────────┬─────────────┬─────────────┬─────────────┬─────────────╮ ╭──────╮
             I3_Q          ____          &kp LS(TAB)   &swapper      I3_SCR          &kp PG_UP     NAV_BSPC      NAV_UP        NAV_DEL       &kp PSCRN           
//├──────┤ ├─────────────┼─────────────┼─────────────┼─────────────┼─────────────┤ ├─────────────┼─────────────┼─────────────┼─────────────┼─────────────┤ ├──────┤
             &sk LGUI      &sk LALT      &sk LCTRL     &sk LSHFT     I3_F            &kp PG_DN     NAV_LEFT      NAV_DOWN      NAV_RIGHT     ____                
//├──────┤ ├─────────────┼─────────────┼─────────────┼─────────────┼─────────────┤ ├─────────────┼─────────────┼─────────────┼─────────────┼─────────────┤ ├──────┤
    X_LB     I3_1          I3_2          I3_3          I3_4          I3_5            &kp INS       &kp TAB       ____          ____          ____            X_RB
//├──────┤ ╰─────────────┴─────────────┼─────────────┼─────────────┼─────────────┤ ├─────────────┼─────────────┼─────────────┼─────────────┴─────────────╯ ├──────┤
                                         ____          ____          ____            &kp LG(SPACE)   &kp LG(RET)  &kp LG(BSPC)                                   
//╰──────╯                             ╰─────────────┴─────────────┴─────────────╯ ╰─────────────┴─────────────┴─────────────╯                             ╰──────╯
)


// tap: amps | shift + tap: pipe
SIMPLE_MORPH(logic_op, SFT, &kp AMPS, &kp PIPE)

// tap: dollar | shift + tap: caret
SIMPLE_MORPH(code_dol, SFT, &kp DOLLAR, &kp CARET)

// tap: semicolon | shift + tap: comma
SIMPLE_MORPH(semi_morph, SFT, &kp SEMI, &kp COMMA)

// tap: COLON | shift + tap: DOT
SIMPLE_MORPH(col_morph, SFT, &kp COLON, &kp DOT)

// tap: excl | shift + tap: tilde
SIMPLE_MORPH(etild, SFT, &kp EXCL, &kp TILDE)

// tap: qmark | shift + tap: star
SIMPLE_MORPH(qstar, SFT, &kp QMARK, &kp STAR)

// tap: FSLH | shift + tap: backslash | ctrl + shift + tap: hash
SIMPLE_MORPH(slash_morph, SFT, &kp FSLH, &slash_inner_morph)
SIMPLE_MORPH(slash_inner_morph, CTL, &kp BSLH, &kp HASH)

ZMK_LAYER(sym_code,
//╭──────╮ ╭─────────────┬─────────────┬─────────────┬─────────────┬─────────────╮ ╭─────────────┬─────────────┬─────────────┬─────────────┬─────────────╮ ╭──────╮
             &code_dol     &kp LBRC      &logic_op     &kp RBRC      &col_morph      ____          ____          ____          ____          ____                
//├──────┤ ├─────────────┼─────────────┼─────────────┼─────────────┼─────────────┤ ├─────────────┼─────────────┼─────────────┼─────────────┼─────────────┤ ├──────┤
             &etild        &kp LPAR      &kp EQUAL     &kp RPAR      &qstar          &kp BSPC      &sk RSHFT     &sk RCTRL     &sk RALT      &sk RGUI            
//├──────┤ ├─────────────┼─────────────┼─────────────┼─────────────┼─────────────┤ ├─────────────┼─────────────┼─────────────┼─────────────┼─────────────┤ ├──────┤
    X_LB     &slash_morph  &kp LBKT      &kp MINUS     &kp RBKT      &semi_morph     &kp DELETE     ____         ____          ____          ____            X_RB
//├──────┤ ╰─────────────┴─────────────┼─────────────┼─────────────┼─────────────┤ ├─────────────┼─────────────┼─────────────┼─────────────┴─────────────╯ ├──────┤
                                         &sqt_morph    ____          ____            ____           ____         ____                                            
//╰──────╯                             ╰─────────────┴─────────────┴─────────────╯ ╰─────────────┴─────────────┴─────────────╯                             ╰──────╯
)

#define N_DOT_OP &mt KP_DIVIDE KP_MULTIPLY
#define N_DASH_OP &mt KP_SUBTRACT KP_PLUS

// tap: star | shift + tap: fslh
SIMPLE_MORPH(opdot, SFT, &kp STAR, &kp FSLH)
// tap: plus | shift + tap: minus
SIMPLE_MORPH(opdas, SFT, &kp PLUS, &kp MINUS)

ZMK_LAYER(numblock,
//╭──────╮ ╭─────────────┬─────────────┬─────────────┬─────────────┬─────────────╮ ╭─────────────┬─────────────┬─────────────┬─────────────┬─────────────╮ ╭──────╮
             &kp COLON     &kp N7        &kp N8        &kp N9        &opdot          ____          ____          ____          ____          ____                
//├──────┤ ├─────────────┼─────────────┼─────────────┼─────────────┼─────────────┤ ├─────────────┼─────────────┼─────────────┼─────────────┼─────────────┤ ├──────┤
             ____          &kp N4        &kp N5        &kp N6        &opdas          ____          &sk RSHFT     &sk RCTRL     &sk RALT      &sk RGUI            
//├──────┤ ├─────────────┼─────────────┼─────────────┼─────────────┼─────────────┤ ├─────────────┼─────────────┼─────────────┼─────────────┼─────────────┤ ├──────┤
    X_LB     ____          &kp N1        &kp N2        &kp N3        ____            ____          ____          ____          ____          ____            X_RB
//├──────┤ ╰─────────────┴─────────────┼─────────────┼─────────────┼─────────────┤ ├─────────────┼─────────────┼─────────────┼─────────────┴─────────────╯ ├──────┤
                                         &kp N0        &kp DOT       ____            ____          ____          ____                                            
//╰──────╯                             ╰─────────────┴─────────────┴─────────────╯ ╰─────────────┴─────────────┴─────────────╯                             ╰──────╯
)

ZMK_LAYER(numf,
//╭──────╮ ╭─────────────┬─────────────┬─────────────┬─────────────┬─────────────╮ ╭─────────────┬─────────────┬─────────────┬─────────────┬─────────────╮ ╭──────╮
             ____          &kp F7        &kp F8        &kp F9        &kp F10         &bt BT_CLR    &bt BT_PRV    &bt BT_NXT    ____          &out OUT_TOG        
//├──────┤ ├─────────────┼─────────────┼─────────────┼─────────────┼─────────────┤ ├─────────────┼─────────────┼─────────────┼─────────────┼─────────────┤ ├──────┤
             ____          &kp F4        &kp F5        &kp F6        &kp F11         ____          &sk RSHFT     &sk RCTRL     &sk RALT      &sk RGUI            
//├──────┤ ├─────────────┼─────────────┼─────────────┼─────────────┼─────────────┤ ├─────────────┼─────────────┼─────────────┼─────────────┼─────────────┤ ├──────┤
    X_LB     ____          &kp F1        &kp F2        &kp F3        &kp F12         ____          ____          ____          &bootloader   &sys_reset      X_RB
//├──────┤ ╰─────────────┴─────────────┼─────────────┼─────────────┼─────────────┤ ├─────────────┼─────────────┼─────────────┼─────────────┴─────────────╯ ├──────┤
                                         &none         &none         &none           ____          ____          ____                                            
//╰──────╯                             ╰─────────────┴─────────────┴─────────────╯ ╰─────────────┴─────────────┴─────────────╯                             ╰──────╯
)


#define ID_GEN  &kp LA(INS)         // generate
#define ID_M    &kp LA(LC(M))       // extract Method
#define ID_P    &kp LA(LC(P))       // extract Parameter
#define ID_C    &kp LA(LC(C))       // extract Constant
#define ID_V    &kp LA(LC(V))       // extract Variable
#define ID_RFT  &mt LS(LC(T)) LS(LC(LA(T)))   // refactor this
#define ID_USE  &kp LS(LA(N7))      // usage
#define ID_S_A  &kp LS(LC(A))       // search actions
#define ID_S_F  &kp LC(N)           // search class
#define ID_TEST &mt LC(F5) LC(LS(F10)) // run test

ZMK_LAYER(idea,
//╭──────╮ ╭─────────────┬─────────────┬─────────────┬─────────────┬─────────────╮ ╭─────────────┬─────────────┬─────────────┬─────────────┬─────────────╮ ╭──────╮
             &kp F2        ____          &kp LS(F6)    ID_USE        ID_TEST         ____          ____          ____          ____          ____                
//├──────┤ ├─────────────┼─────────────┼─────────────┼─────────────┼─────────────┤ ├─────────────┼─────────────┼─────────────┼─────────────┼─────────────┤ ├──────┤
             ID_S_A        ID_S_F        ____          ID_GEN        ID_RFT          ____          &sk RSHFT     &sk RCTRL     &sk RALT      &sk RGUI            
//├──────┤ ├─────────────┼─────────────┼─────────────┼─────────────┼─────────────┤ ├─────────────┼─────────────┼─────────────┼─────────────┼─────────────┤ ├──────┤
    X_LB     ID_M          ID_P          ID_C          ID_V          ____            ____          ____          ____          ____          ____            X_RB
//├──────┤ ╰─────────────┴─────────────┼─────────────┼─────────────┼─────────────┤ ├─────────────┼─────────────┼─────────────┼─────────────┴─────────────╯ ├──────┤
                                         ____          ____          ____            ____          ____          ____                                            
//╰──────╯                             ╰─────────────┴─────────────┴─────────────╯ ╰─────────────┴─────────────┴─────────────╯                             ╰──────╯
)



ZMK_LAYER(mc,
//╭──────╮ ╭─────────────┬─────────────┬─────────────┬─────────────┬─────────────╮ ╭─────────────┬─────────────┬─────────────┬─────────────┬─────────────╮ ╭──────╮
             ____          &kp Q         ____          &kp F         &kp V           &kp Y         &kp U         &kp I         &kp O         &sqt_morph          
//├──────┤ ├─────────────┼─────────────┼─────────────┼─────────────┼─────────────┤ ├─────────────┼─────────────┼─────────────┼─────────────┼─────────────┤ ├──────┤
             &kp LSHFT     &kp A         &kp W         &kp D         &kp R           &kp H         &hmr RSHFT J  &hmr LCTRL K  &hmr LALT L   &hmr LGUI P         
//├──────┤ ├─────────────┼─────────────┼─────────────┼─────────────┼─────────────┤ ├─────────────┼─────────────┼─────────────┼─────────────┼─────────────┤ ├──────┤
    X_LB     ____          ____          &kp S         ____          &kp B           &kp N         &kp M         &comma_morph  &dot_morph    &qexcl          X_RB
//├──────┤ ╰─────────────┴─────────────┼─────────────┼─────────────┼─────────────┤ ├─────────────┼─────────────┼─────────────┼─────────────┴─────────────╯ ├──────┤
                                         &kp E         &kp N8        &kp SPACE       T_L_LFT      T_L_MID       T_L_RGT                                          
//╰──────╯                             ╰─────────────┴─────────────┴─────────────╯ ╰─────────────┴─────────────┴─────────────╯                             ╰──────╯
)
